#define appNameClass    PedometerAppTest         // App name without spaces
#define appName         "Pedometer"              // App name with spaces 

#ifndef PEDOMETER_APP_TEST_FONT_SIZE
    #define PEDOMETER_APP_TEST_FONT_SIZE FONT_SIZE_DEFAULT
#endif

class appNameClass: public Application{
    public:
        virtual void onLoop() override;
        virtual void onDestroy() override;
        virtual void onEvent(unsigned char event, int val1, int val2, int val3, int val4, int val5) override;

        void onCreate();
        appNameClass(){ 
            fillScreen(0, 0, 0);  // filling background
            super_onCreate();           // Drawind statusbar and etc if needed
            onCreate(); 
        };

        static unsigned const char* getParams(const unsigned char type){
            switch(type){ 
              case PARAM_TYPE_NAME: return (unsigned char*)appName; 
              case PARAM_TYPE_ICON: return icon;
              default: return (unsigned char*)""; }
        };
        const static unsigned char icon[] PROGMEM;
        void drawStringOnScreen(bool draw, String stringToPrint);
        int currentPrintScreenString = 0;
        float acceleration_max = 0;
        float acceleration_min = 0;
      
        String step_app_pedometr_test = "-";
        String sleep_app_pedometr_test = "-";
        String mesures_ms_app_pedometr_test = "-";
        String mesures_app_pedometr_test = "-";

        String accel_x_app_pedometr_test = "-";
        String accel_y_app_pedometr_test = "-";
        String accel_z_app_pedometr_test = "-";

        String accel_total_app_pedometr_test = "-";

        String delta_app_pedometr_test = "-";
        String central_weight_app_pedometr_test = "-";
        String mesure_delay_app_pedometr_test = "-";
};

void appNameClass::onCreate(){
    /*
        Write you code on App create here
    */
    this->preventSleep         = true;
    this->preventInAppSleep    = true;

    DRAW_LIMITS_setEnable(true);
    DRAW_LIMIT_reset();
    DRAW_LIMITS_setEnable(STYLE_STATUSBAR_HEIGHT, -1, -1, -1);
    
    setBackgroundColor(0,0,0);
    setContrastColor(255, 255, 255);
    setDrawColor_ContrastColor();
    
    //drawString(appName, 5, STYLE_STATUSBAR_HEIGHT + 10, FONT_SIZE_DEFAULT);
    //core_pedometer_start_step_detection();
}

void appNameClass::drawStringOnScreen(bool draw, String stringToPrint){

    if(draw) setDrawColor_ContrastColor();
    else setDrawColor_BackGroundColor();

    #ifdef ROUND_SCREEN
        drawString_centered(stringToPrint, SCREEN_WIDTH/2, STYLE_STATUSBAR_HEIGHT + currentPrintScreenString*10*PEDOMETER_APP_TEST_FONT_SIZE + 10, PEDOMETER_APP_TEST_FONT_SIZE);
    #else
        drawString(stringToPrint, 5, STYLE_STATUSBAR_HEIGHT + currentPrintScreenString*10*PEDOMETER_APP_TEST_FONT_SIZE + 10, PEDOMETER_APP_TEST_FONT_SIZE);
    #endif
    
    if(draw)currentPrintScreenString ++;
}


void appNameClass::onLoop(){
    /*
        Write you code onLoop here
    */
       currentPrintScreenString = 0;

    //drawRect(0,0, SCREEN_WIDTH, SCREEN_HEIGHT, true);

    #ifdef ACCELEROMETER_ENABLE
        driver_accelerometer_update_accelerometer();

        #ifdef PEDOMETER_ENABLE
            if(this->step_app_pedometr_test != String(get_pedometer_days_steps())){
                drawStringOnScreen(false, "Steps: " + step_app_pedometr_test);
                this->step_app_pedometr_test = String(get_pedometer_days_steps());
                drawStringOnScreen(true, "Steps: " + step_app_pedometr_test);
            }else currentPrintScreenString ++;
            

            if(this->sleep_app_pedometr_test != String(get_pedometer_days_sleep())){
                drawStringOnScreen(false, "Sleep: " + sleep_app_pedometr_test);
                this->sleep_app_pedometr_test = String(get_pedometer_days_sleep());
                drawStringOnScreen(true, "Sleep: " + sleep_app_pedometr_test);
            }else currentPrintScreenString ++;
            
            if(this->mesures_ms_app_pedometr_test != String(get_corePedometer_currentsleep_between_mesures())){
                drawStringOnScreen(false, "Mesures ms: " + mesures_ms_app_pedometr_test);
                this->mesures_ms_app_pedometr_test = String(get_corePedometer_currentsleep_between_mesures());
                drawStringOnScreen(true, "Mesures ms: " + mesures_ms_app_pedometr_test);
            }else currentPrintScreenString ++;
            
            if(this->mesures_app_pedometr_test != String(getPedometr_mesurings_in_a_day())){
                drawStringOnScreen(false, "Mesures: " + mesures_app_pedometr_test);
                this->mesures_app_pedometr_test = String(getPedometr_mesurings_in_a_day());
                drawStringOnScreen(true, "Mesures: " + mesures_app_pedometr_test);
            }else currentPrintScreenString ++;
            
            drawStringOnScreen(true, "");
            drawStringOnScreen(true, "Accels X Y Z:");
            if(this->accel_x_app_pedometr_test != String(get_driver_accelerometer_x())){
                drawStringOnScreen(false, accel_x_app_pedometr_test);
                this->accel_x_app_pedometr_test = String(get_driver_accelerometer_x());
                drawStringOnScreen(true, accel_x_app_pedometr_test);
            }else currentPrintScreenString ++;
            
            if(this->accel_y_app_pedometr_test != String(get_driver_accelerometer_y())){
                drawStringOnScreen(false, accel_y_app_pedometr_test);
                this->accel_y_app_pedometr_test = String(get_driver_accelerometer_y());
                drawStringOnScreen(true, accel_y_app_pedometr_test);
            }else currentPrintScreenString ++;
            
            if(this->accel_z_app_pedometr_test != String(get_driver_accelerometer_z())){
                drawStringOnScreen(false, accel_z_app_pedometr_test);
                this->accel_z_app_pedometr_test = String(get_driver_accelerometer_z());
                drawStringOnScreen(true, accel_z_app_pedometr_test);
            }else currentPrintScreenString ++;
            
            if(this->accel_total_app_pedometr_test != String(driver_accelerometer_get_accel_total())){
                drawStringOnScreen(false, "Accerometer total: " + accel_total_app_pedometr_test);
                this->accel_total_app_pedometr_test = String(driver_accelerometer_get_accel_total());
                drawStringOnScreen(true, "Accerometer total: " + accel_total_app_pedometr_test);
            }else currentPrintScreenString ++;
            
            #ifdef DEBUG_PEDOMETER
                drawStringOnScreen(true, " ");
                if(this->delta_app_pedometr_test != String(get_analysis_delta_value())){
                    drawStringOnScreen(false, "Delta: " + delta_app_pedometr_test);
                    this->delta_app_pedometr_test = String(get_analysis_delta_value());
                    drawStringOnScreen(true, "Delta: " + delta_app_pedometr_test);
                }else currentPrintScreenString ++;
            
            
                drawStringOnScreen(true, "Central weight: ");
                if(this->central_weight_app_pedometr_test != String(get_analysis_central_weight_value())){
                    drawStringOnScreen(false, central_weight_app_pedometr_test);
                    this->central_weight_app_pedometr_test = String(get_analysis_central_weight_value());
                    drawStringOnScreen(true, central_weight_app_pedometr_test);
                }else currentPrintScreenString ++;

            #endif
            drawStringOnScreen(true, "");
            drawStringOnScreen(true, "Mesure delay: ");
            if(this->mesure_delay_app_pedometr_test != String(get_corePedometer_currentsleep_between_mesures())){
                drawStringOnScreen(false, mesure_delay_app_pedometr_test);
                this->mesure_delay_app_pedometr_test = String(get_corePedometer_currentsleep_between_mesures());
                drawStringOnScreen(true, mesure_delay_app_pedometr_test);
            }else currentPrintScreenString ++;
            
        #endif
        
    #endif
    
}

void appNameClass::onDestroy(){
    /*
        Write you code onDestroy here
    */
    //digitalWrite(10,1);
    
}

void appNameClass::onEvent(unsigned char event, int val1, int val2, int val3, int val4, int val5){
    
     #ifdef TOUCH_SCREEN_ENABLE

        if(event==EVENT_ON_TOUCH_DRAG){
        } 
        else if(event==EVENT_BUTTON_PRESSED){
            if(val1==BUTTON_POWER){
                startApp(-1);
            }
            else if(val1==BUTTON_BACK){
                startApp(-1);
            }
        }

    #else

        /**/
        #if (DRIVER_CONTROLS_TOTALBUTTONS == 2 || DRIVER_CONTROLS_TOTALBUTTONS == 1)
            
            if(event==EVENT_BUTTON_PRESSED){
            }else if(event==EVENT_BUTTON_RELEASED){
            }else if(event==EVENT_BUTTON_LONG_PRESS){
                if(val1==BUTTON_SELECT){
                    acceleration_max = 0;
                    acceleration_min = 0;
                    #ifdef PEDOMETER_ENABLE
                        set_pedometer_days_steps(0,0);
                        set_pedometer_days_sleep(0,0);
                    #endif
                }else if(val1==BUTTON_BACK){
                    startApp(-1);
                }    
            }else if(event==EVENT_BUTTON_SHORT_PRESS){
            }else if(event==EVENT_BUTTON_SHORT_SINGLE_PRESS){
                if(val1==BUTTON_SELECT){
                }else if(val1==BUTTON_BACK){
                }
            }else if(event==EVENT_BUTTON_DOUBLE_PRESS){
                #if (DRIVER_CONTROLS_TOTALBUTTONS == 1)
                    if(val1==BUTTON_SELECT){
                        startApp(-1);
                    }
                #else
                #endif
                
            }
            
        #else
            if(event==EVENT_BUTTON_PRESSED){
                switch(val1){
                    case BUTTON_UP:
                        break;
                    case BUTTON_BACK:
                        break;
                    case BUTTON_DOWN:
                        break;
                    case BUTTON_SELECT:
                        break;
                }
            }else if(event==EVENT_BUTTON_RELEASED){

            }else if(event==EVENT_BUTTON_LONG_PRESS){

            }
        #endif
    
    #endif
    
}

const unsigned char appNameClass::icon[] PROGMEM = {
    
	    #ifdef USE_L_MENU_IMAGES
    #elif defined(USE_XL_MENU_IMAGES)
        0x02,0x01,0x02,0x50,0x02,0x50,0x04,0x00,0x00,0x33,0x00,0x00,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0x00,
    #else
        // small image
        0x02,0x01,0x02,0x20,0x02,0x20,0x04,0xff,0xff,0xff,0x00,0x00,0x07,0xF0,0x00,0x00,0x0F,0xF8,0x00,0x00,0x1F,
        0xFC,0x07,0xC0,0x1F,0xFC,0x1F,0xE0,0x3F,0xFE,0x3F,0xF0,0x3F,0xFE,0x3F,0xF0,0x3F,0xFE,0x3F,0xF8,0x3F,0xFE,
        0x7F,0xF8,0x1F,0xFE,0x7F,0xF8,0x1F,0xFE,0x7F,0xFC,0x0F,0xFE,0x7F,0xFC,0x0F,0xFE,0x3F,0xFC,0x0F,0xFC,0x3F,
        0xFC,0x07,0xFC,0x1F,0xFC,0x07,0xFC,0x1F,0xF8,0x03,0xF8,0x1F,0xF8,0x00,0x00,0x0F,0xF8,0x00,0x00,0x07,0xF8,
        0x00,0x00,0x07,0xE0,0x03,0xF8,0x03,0x00,0x07,0xFC,0x00,0x00,0x07,0xFC,0x00,0x06,0x07,0xFC,0x00,0x3E,0x07,
        0xFC,0x01,0xFF,0x03,0xFC,0x03,0xFF,0x03,0xF8,0x03,0xFF,0x01,0xF0,0x01,0xFF,0x00,0x00,0x01,0xFE,0x00,0x00,
        0x00,0xFC,0x00,0x00,0x00,0x30,0x00,0x00,0x00,0x00,0x00,0x00,
    #endif
};