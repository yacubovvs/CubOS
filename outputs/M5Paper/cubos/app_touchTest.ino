#define appNameClass    TouchTest         // App name without spaces
#define appName         "Touch test"              // App name with spaces 

//#define APP_TOUCH_TEST_DEBUG

class appNameClass: public Application{
    public:
        virtual void onLoop() override;
        virtual void onDestroy() override;
        virtual void onEvent(unsigned char event, int val1, int val2, int val3, int val4, int val5) override;

        void onCreate();
        void drawLabelFingers(bool draw, unsigned char event, unsigned char finger, int x, int y);
        appNameClass(){ 
            fillScreen(0, 0, 0);  // filling background
            super_onCreate();           // Drawind statusbar and etc if needed
            onCreate(); 
        };

        static unsigned const char* getParams(const unsigned char type){
            switch(type){ 
              case PARAM_TYPE_NAME: return (unsigned char*)appName; 
              case PARAM_TYPE_ICON: return icon;
              default: return (unsigned char*)""; }
        };
        const static unsigned char icon[] PROGMEM;

        uint8_t lastEvent[MULTITOUCH_SCREEN_FINGERS];
        int last_x[MULTITOUCH_SCREEN_FINGERS];
        int last_y[MULTITOUCH_SCREEN_FINGERS];
        int last_x_drag[MULTITOUCH_SCREEN_FINGERS];
        int last_y_drag[MULTITOUCH_SCREEN_FINGERS];
      
};

void appNameClass::onCreate(){
    /*
        Write you code on App create here
    */

    DRAW_LIMITS_setEnable(true);
    DRAW_LIMIT_reset();
    DRAW_LIMITS_setEnable(STYLE_STATUSBAR_HEIGHT, -1, -1, -1);

    for(unsigned char finger=0; finger<MULTITOUCH_SCREEN_FINGERS; finger++){
        lastEvent[MULTITOUCH_SCREEN_FINGERS] = 0;
        last_x[MULTITOUCH_SCREEN_FINGERS] = 0;
        last_y[MULTITOUCH_SCREEN_FINGERS] = 0;
        last_x_drag[MULTITOUCH_SCREEN_FINGERS] = -1;
        last_y_drag[MULTITOUCH_SCREEN_FINGERS] = -1;
    }

    #ifdef LIGHT_COLOR_THEME
        setBackgroundColor(255, 255, 255);
        setDrawColor(0, 0, 0);
    #else
        setBackgroundColor(0, 0, 0);
        setDrawColor(255, 255, 255);
    #endif
    
    for(uint8_t finger=0; finger<MULTITOUCH_SCREEN_FINGERS; finger++){
        drawLabelFingers(true, 0x00, finger, 0, 0);
    }
}

void appNameClass::onLoop(){
    /*
        Write you code onLoop here
    */

    /*
    setBackgroundColor(0, 0, 0);
    setDrawColor(0, 0, 0);
    clearString("25500", 5, STYLE_STATUSBAR_HEIGHT + 3*20 + 10, 2);
    
    setDrawColor(255, 255, 255);
    drawString(getDe(), 5, STYLE_STATUSBAR_HEIGHT + 3*20 + 10, 2);
    //drawString(String((int) 2), 5, STYLE_STATUSBAR_HEIGHT + 3*20 + 10, 2);
    */
}

void appNameClass::onDestroy(){
    /*
        Write you code onDestroy here
    */
}

void appNameClass::drawLabelFingers(bool draw, unsigned char event, unsigned char finger, int x, int y){

    #ifdef LIGHT_COLOR_THEME
        if(draw) setDrawColor(0, 0, 0);
        else setDrawColor(255, 255, 255);
    #else
        if(draw) setDrawColor(255, 255, 255);
        else setDrawColor(0, 0, 0);
    #endif

    String eventString = "Not touched";

    
    switch(event){
        case EVENT_ON_TOUCH_START:
            eventString = "Touch start"; break;
        case EVENT_ON_TOUCH_RELEASED:
            eventString = "Touch released"; break;
        case EVENT_ON_TOUCH_DRAG:
            eventString = "Touch drag"; break;
        case EVENT_ON_TOUCH_LONG_PRESS:
            eventString = "Touch long press"; break;
        case EVENT_ON_TOUCH_CLICK:
            eventString = "Touch click"; break;
        case EVENT_ON_TOUCH_QUICK_SWIPE_TO_RIGHT:
            eventString = "Touch quick swipe right"; break;
        case EVENT_ON_TOUCH_QUICK_SWIPE_TO_LEFT:
            eventString = "Touch quick swipe left"; break;
        case EVENT_ON_TOUCH_QUICK_SWIPE_TO_BOTTOM:
            eventString = "Touch quick swipe bottom"; break;
        case EVENT_ON_TOUCH_QUICK_SWIPE_TO_TOP:
            eventString = "Touch quick swipe top"; break;
    }

    //#define MARKER_FONT_SIZE (FONT_SIZE_DEFAULT*3/2)
    #define MARKER_FONT_SIZE 3

    if(draw){
        lastEvent[finger]   = event;
        last_x[finger]      = x;
        last_y[finger]      = y;

        if(event!=EVENT_ON_TOUCH_RELEASED){
            drawCircle(x, y, 20, false);
            drawString(String(finger), x - (FONT_CHAR_WIDTH-1)*MARKER_FONT_SIZE/2, y - (FONT_CHAR_HEIGHT-2)*MARKER_FONT_SIZE/2, MARKER_FONT_SIZE);
        }

        drawString("   Finger: " + String(finger),          10*FONT_SIZE_DEFAULT, STYLE_STATUSBAR_HEIGHT + (finger*4 + 0)*20 + 10, FONT_SIZE_DEFAULT);
        drawString(eventString,                             10*FONT_SIZE_DEFAULT, STYLE_STATUSBAR_HEIGHT + (finger*4 + 1)*20 + 10, FONT_SIZE_DEFAULT);
        drawString("X:" + String(x) + "    Y:" + String(y), 10*FONT_SIZE_DEFAULT, STYLE_STATUSBAR_HEIGHT + (finger*4 + 2)*20 + 10, FONT_SIZE_DEFAULT);
    }else{

        if(lastEvent[finger]!=EVENT_ON_TOUCH_RELEASED){
            drawCircle(last_x[finger], last_y[finger], 20, false);
            clearString(String(finger), x - (FONT_CHAR_WIDTH-1)*MARKER_FONT_SIZE/2, y - (FONT_CHAR_HEIGHT-2)*MARKER_FONT_SIZE/2, MARKER_FONT_SIZE);
        }

        clearString("   Finger: " + String(finger),          10*FONT_SIZE_DEFAULT, STYLE_STATUSBAR_HEIGHT + (finger*4 + 0)*20 + 10, FONT_SIZE_DEFAULT);
        clearString(eventString,                             10*FONT_SIZE_DEFAULT, STYLE_STATUSBAR_HEIGHT + (finger*4 + 1)*20 + 10, FONT_SIZE_DEFAULT);
        clearString("X:" + String(x) + "    Y:" + String(y), 10*FONT_SIZE_DEFAULT, STYLE_STATUSBAR_HEIGHT + (finger*4 + 2)*20 + 10, FONT_SIZE_DEFAULT);
    }
    

    #ifdef APP_TOUCH_TEST_DEBUG
        if(draw) debug(eventString + " on finger " + String(finger) + ", X: " + String(x) + ", Y: " + String(y));
    #endif
}

void appNameClass::onEvent(unsigned char event, int val1, int val2, int val3, int val4, int val5){

    if(event==EVENT_BUTTON_PRESSED){
        // Write you code on [val1] button pressed here
        if(val1==BUTTON_BACK){
            startApp(-1);
        }
        if(val1==BUTTON_POWER){
            startApp(-1);
        }
    }else if(event==EVENT_BUTTON_RELEASED){
        // Write you code on [val1] button released here
    }else if(event==EVENT_BUTTON_LONG_PRESS){
        // Write you code on [val1] button long press here
    }else if(event==EVENT_ON_TIME_CHANGED){
        // Write you code on system time changed
    }else if(event==EVENT_ON_TOUCH_QUICK_SWIPE_TO_TOP){
        #ifdef APP_TOUCH_TEST_DEBUG
            debug("SWIPE TOP");
        #endif
        startApp(-1);
    }else if(event==EVENT_ON_TOUCH_START){
        
        this->drawLabelFingers(false, lastEvent[val5], val5, last_x[val5], last_y[val5]);
        #ifdef LIGHT_COLOR_THEME
            setDrawColor(0, 0, 0);
        #else
            setDrawColor(255, 255, 255);
        #endif  

        last_x_drag[val5] = val1;
        last_y_drag[val5] = val2;

        this->drawLabelFingers(true, event, val5, val1, val2);
        //drawString("   Finger: " + String(val5), 5, STYLE_STATUSBAR_HEIGHT + 0*20 + 10, 2);
        //drawString("Touch start", 5, STYLE_STATUSBAR_HEIGHT + 1*20 + 10, 2);
        //drawString("X:" + String(val1) + " Y:" + String(val2), 5, STYLE_STATUSBAR_HEIGHT + 2*20 + 10, 2);
        #ifdef PARTIAL_DISPLAY_DRAWING
            driver_display_partial_loop();
        #endif

        #ifdef APP_TOUCH_TEST_DEBUG
            debug("Touch start      X:" + String(val1) + "     Y: " + String(val2) + "     Finger: " + val5);
        #endif
    }else if(event==EVENT_ON_TOUCH_RELEASED){
        /*
        val1 = released X
        val2 = released Y
        val5 = touch num
        */

       #ifdef LIGHT_COLOR_THEME
            setDrawColor(0, 0, 0);
        #else
            setDrawColor(255, 255, 255);
        #endif

        if(
            last_x_drag[val5]!=-1 && last_x_drag[val5]!=last_x[val5]
            && last_y_drag[val5]!=-1 && last_y_drag[val5]!=last_y[val5]
        ){
            #ifdef LIGHT_COLOR_THEME
                setDrawColor(255, 255, 255);
            #else
                setDrawColor(0, 0, 0);
            #endif
            // Clearing line
            drawLine(last_x[val5], last_y[val5], last_x_drag[val5], last_y_drag[val5]);
            #ifdef LIGHT_COLOR_THEME
                setDrawColor(0, 0, 0);
            #else
                setDrawColor(255, 255, 255);
            #endif
        }
        

        last_x_drag[val5] = -1;
        last_y_drag[val5] = -1;

        this->drawLabelFingers(false, lastEvent[val5], val5, last_x[val5], last_y[val5]);

        #ifdef LIGHT_COLOR_THEME
            setDrawColor(0, 0, 0);
        #else
            setDrawColor(255, 255, 255);
        #endif
        
        this->drawLabelFingers(true, event, val5, val1, val2);
        #ifdef PARTIAL_DISPLAY_DRAWING
            driver_display_partial_loop();
        #endif

    }else if(event==EVENT_ON_TOUCH_DRAG){

        this->drawLabelFingers(false, lastEvent[val5], val5, last_x[val5], last_y[val5]);

        #ifdef LIGHT_COLOR_THEME
            setDrawColor(0, 0, 0);
        #else
            setDrawColor(255, 255, 255);
        #endif

        #ifdef LIGHT_COLOR_THEME
            setDrawColor(255, 255, 255);
        #else
            setDrawColor(0, 0, 0);
        #endif
        // Clearing line
        drawLine(val3, val4, last_x_drag[val5], last_y_drag[val5]);
        #ifdef LIGHT_COLOR_THEME
            setDrawColor(0, 0, 0);
        #else
            setDrawColor(255, 255, 255);
        #endif

        last_x_drag[val5] += val1;
        last_y_drag[val5] += val2;
        
        drawLine(val3, val4, last_x_drag[val5], last_y_drag[val5]);

        this->drawLabelFingers(true, event, val5, val3, val4);
        #ifdef PARTIAL_DISPLAY_DRAWING
            driver_display_partial_loop();
        #endif

    }else if(event==EVENT_ON_TOUCH_LONG_PRESS){
        this->drawLabelFingers(false, lastEvent[val5], val5, last_x[val5], last_y[val5]);

        #ifdef LIGHT_COLOR_THEME
            setDrawColor(0, 0, 0);
        #else
            setDrawColor(255, 255, 255);
        #endif

        this->drawLabelFingers(true, event, val5, val1, val2);
        #ifdef PARTIAL_DISPLAY_DRAWING
            driver_display_partial_loop();
        #endif

    }
}

const unsigned char appNameClass::icon[] PROGMEM = {
    
#if defined(USE_XL_MENU_IMAGES)
    #ifdef COLOR_GRAY_16
        0x02,0x01,0x02,0x50,0x02,0x50,0x04,0x7E,0x7E,0x7E,0x00,0x00,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0x00,
    #else
        0x02,0x01,0x02,0x50,0x02,0x50,0x04,0x00,0x00,0x40,0x00,0x00,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0x00,
    #endif
    
#elif defined(USE_L_MENU_IMAGES)
   
#else
    /*            PUT YOUR ICON HERE            */
    0x02,0x01,0x02,0x20,0x02,0x20,0x04,0xff,0xff,0xff,0xFF,0x00,0x00,0xFF,0xFF,0x00,0x00,0xFF,0xC0,0x00,0x00,0x03,
    0xC0,0x00,0x00,0x03,0xC0,0x00,0x00,0x03,0xC0,0x00,0x00,0x03,0xC0,0x00,0x00,0x03,0xC0,0x00,0x00,0x03,0x00,0x00,
    0x00,0x00,0x00,0x00,0x00,0x00,0x00,0x01,0x80,0x00,0x00,0x01,0x80,0x00,0x00,0x01,0x80,0x00,0x00,0x01,0x80,0x00,
    0x00,0x01,0x80,0x00,0x00,0x3F,0xFC,0x00,0x00,0x3F,0xFC,0x00,0x00,0x01,0x80,0x00,0x00,0x01,0x80,0x00,0x00,0x01,
    0x80,0x00,0x00,0x01,0x80,0x00,0x00,0x01,0x80,0x00,0x00,0x00,0x00,0x00,0x00,0x00,0x00,0x00,0xC0,0x00,0x00,0x03,
    0xC0,0x00,0x00,0x03,0xC0,0x00,0x00,0x03,0xC0,0x00,0x00,0x03,0xC0,0x00,0x00,0x03,0xC0,0x00,0x00,0x03,0xFF,0x00,
    0x00,0xFF,0xFF,0x00,0x00,0xFF,
#endif
	

    
};