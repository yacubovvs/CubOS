#define appNameClass    TestButtonsApp         // App name without spaces
#define appName         "Buttons"              // App name with spaces 

class appNameClass: public Application{
    public:
        virtual void onLoop() override;
        virtual void onDestroy() override;
        virtual void onEvent(unsigned char event, int val1, int val2, int val3, int val4, int val5) override;

        void onCreate();
        appNameClass(){ 
            #ifdef LIGHT_COLOR_THEME
                fillScreen(255, 255, 255); 
            #else
                fillScreen(0, 0, 0); 
            #endif
            super_onCreate();           // Drawind statusbar and etc if needed
            onCreate(); 
        };

        static unsigned const char* getParams(const unsigned char type){
            switch(type){ 
              case PARAM_TYPE_NAME: return (unsigned char*)appName; 
              case PARAM_TYPE_ICON: return icon;
              default: return (unsigned char*)""; }
        };
        const static unsigned char icon[] PROGMEM;
        unsigned char btns_events[DRIVER_CONTROLS_TOTALBUTTONS];
        void printButtonEvent(bool draw, unsigned char event, unsigned char btnNum);
};

void appNameClass::onCreate(){
    #ifdef LIGHT_COLOR_THEME
        setBackgroundColor(255, 255, 255); 
        setContrastColor(0, 0, 0);
    #else
        setBackgroundColor(0, 0, 0);
        setContrastColor(255, 255, 255);
    #endif
    
    setDrawColor_ContrastColor();   
    //this->preventSleep         = true;
    //this->preventInAppSleep    = true;

    DRAW_LIMITS_setEnable(true);
    DRAW_LIMIT_reset();
    DRAW_LIMITS_setEnable(STYLE_STATUSBAR_HEIGHT, -1, -1, -1);

    drawString(appName, 5, STYLE_STATUSBAR_HEIGHT + 10, FONT_SIZE_DEFAULT);

    for(unsigned char i=0; i<DRIVER_CONTROLS_TOTALBUTTONS; i++){
        btns_events[DRIVER_CONTROLS_TOTALBUTTONS] = 0;
        printButtonEvent(true, 0xFF, i);
    }
    
}

void appNameClass::printButtonEvent(bool draw, unsigned char event, unsigned char btnNum){
    if(draw){
        setDrawColor_ContrastColor();
        this->btns_events[btnNum] = event;
    }else setDrawColor_BackGroundColor();
    
    String btnEvent = "-";

    switch (event){
        case EVENT_BUTTON_PRESSED:
            btnEvent = "PRESSED";
            break;
        case EVENT_BUTTON_RELEASED:
            btnEvent = "RELEASED";
            break;
        case EVENT_BUTTON_LONG_PRESS:
            btnEvent = "LONG PRESS";
            break;
        default:
            btnEvent = "-";
            break;
    }

    drawString("Button " + String(btnNum) + "  event: " + btnEvent, 5, STYLE_STATUSBAR_HEIGHT + 10*FONT_SIZE_DEFAULT*(btnNum+2)-5, FONT_SIZE_DEFAULT);
    
}

void appNameClass::onLoop(){
    /*
        Write you code onLoop here
    */    
}

void appNameClass::onDestroy(){
    /*
        Write you code onDestroy here
    */
}

void appNameClass::onEvent(unsigned char event, int val1, int val2, int val3, int val4, int val5){
    
    #ifdef TOUCH_SCREEN_ENABLE
        /*
        if(event==EVENT_ON_TOUCH_QUICK_SWIPE_TO_TOP){
            startApp(-1);
        }else if(event==EVENT_ON_TOUCH_QUICK_SWIPE_TO_BOTTOM){
            startApp(-1);
        }
        */
       
        if(event==EVENT_ON_TOUCH_START){
            startApp(-1);
        }
        
    #endif

    if(event==EVENT_BUTTON_PRESSED){
        // Write you code on [val1] button pressed here
        #if DRIVER_CONTROLS_TOTALBUTTONS > 3
            if(val1==BUTTON_BACK){
                startApp(-1);
            }
        #endif
        if(val1==BUTTON_POWER){
            startApp(-1);
        }

        printButtonEvent(false, this->btns_events[val5], val5);
        printButtonEvent(true, event, val5);
        #ifdef PARTIAL_DISPLAY_DRAWING
            driver_display_partial_loop();
        #endif
        
    }else if(event==EVENT_BUTTON_RELEASED){
        // Write you code on [val1] button released here
        printButtonEvent(false, this->btns_events[val5], val5);
        printButtonEvent(true, event, val5);
        #ifdef PARTIAL_DISPLAY_DRAWING
            driver_display_partial_loop();
        #endif
    }else if(event==EVENT_BUTTON_LONG_PRESS){
        // Write you code on [val1] button long press here
        printButtonEvent(false, this->btns_events[val5], val5);
        printButtonEvent(true, event, val5);
        #ifdef PARTIAL_DISPLAY_DRAWING
            driver_display_partial_loop();
        #endif
        
        if(val1==BUTTON_SELECT){

            #if DRIVER_CONTROLS_TOTALBUTTONS == 1
                startApp(-1);
            #elif DRIVER_CONTROLS_TOTALBUTTONS == 2
                startApp(-1);
            #else
            #endif
        }
        
    }else if(event==EVENT_ON_TIME_CHANGED){
    }else if(event==EVENT_ON_GOING_TO_SLEEP){
    }else if(event==EVENT_ON_WAKE_UP){
    }
    
}

const unsigned char appNameClass::icon[] PROGMEM = {
    
    #ifdef USE_L_MENU_IMAGES
    #elif defined(USE_XL_MENU_IMAGES)
        #ifdef COLOR_GRAY_16
            0x02,0x01,0x02,0x50,0x02,0x50,0x04,0x7E,0x7E,0x7E,0x00,0x00,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0x00,
        #else
            0x02,0x01,0x02,0x50,0x02,0x50,0x04,0x7E,0x7E,0x7E,0x00,0x00,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0x00,
        #endif
    #else
        // small image
        /*            PUT YOUR ICON HERE            */
        0x02,0x01,0x02,0x20,0x02,0x20,0x04,0x6f,0x00,0xff,0x00,0x00,0x00,0x00,0x00,0x00,0x00,0x00,0x00,0x00,0x00,0x00,0x00,0x00,0x00,0x00,0x00,
        0x00,0x00,0x00,0x00,0x00,0x00,0x00,0x00,0x00,0x00,0x00,0x00,0x00,0x00,0x00,0x00,0x00,0x00,0x00,0x00,0x00,0x06,0x00,0x00,0x00,0x1E,0x00,
        0x00,0x00,0x7E,0x00,0x00,0x00,0x7E,0x00,0x00,0x00,0x7E,0x00,0x00,0x00,0x7E,0x00,0x00,0x00,0x7E,0x00,0x00,0x00,0x7E,0x00,0x00,0x00,0x78,
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        0x00,0x24,0x9A,0x00,0x00,0x24,0x92,0x00,0x00,0x38,0x92,0x00,0x00,0x00,0x00,0x00,0x00,0x00,0x00,0x00,0x00,0x00,0x00,0x00,
    #endif
    
	
};