
#define appNameClass    ClockApp          // App name without spaces
#define appName         "Clock"              // App name with spaces 

#ifndef APP_CLOCK_POWER_AFTER_SECONDS
    #define APP_CLOCK_POWER_AFTER_SECONDS 0 
#endif

#define APP_CLOCK_BIG_SCREEN_CIRCLE_RING_OFFSET 20
#define APP_CLOCK_CIRCLE_COLOR 48
#define APP_CLOCK_BIG_SCREEN_FADE_SIZE 23 // temporary not used

class appNameClass: public Application{
    public:
        bool isfullScreen         = true;
        virtual void onLoop() override;
        virtual void onDestroy() override;
        virtual void onEvent(unsigned char event, int val1, int val2, int val3, int val4, int val5) override;

        void onCreate();
        appNameClass(){ 
            fillScreen(255, 255, 255); 
            this->showStatusBar = false;
            super_onCreate(); 
            onCreate(); 
        };
        static unsigned const char* getParams(const unsigned char type){
            switch(type){ 
              case PARAM_TYPE_NAME: return (unsigned char*)appName; 
              case PARAM_TYPE_ICON: return icon;
              default: return (unsigned char*)""; }
        };
        const static unsigned char icon[] PROGMEM;

        bool draw_current_time(bool draw);

        String last_hours           = "";
        String last_minutes         = "";

        String last_date            = "";
        String day_of_week          = "";

        #ifdef BATTERY_ENABLE
            String battery_string   = "";
            bool last_battery_charging  = false;
        #endif
      
};

void appNameClass::onCreate(){
    DRAW_LIMITS_setEnable(true);
    DRAW_LIMIT_reset();
    
    setBackgroundColor(255, 255, 255);
    setContrastColor(0, 0, 0);

    this->draw_current_time(true);
    //setDrawColor_ContrastColor();
    //setDrawColor_BackGroundColor();
}

void appNameClass::onLoop(){
    /*
        Write you code onLoop here
    */
}

void appNameClass::onDestroy(){
    /*
        Write you code onDestroy here
    */
}

void appNameClass::onEvent(unsigned char event, int val1, int val2, int val3, int val4, int val5){
    #ifdef TOUCH_SCREEN_ENABLE
        if(event==EVENT_ON_TOUCH_START){
            startApp(-1);
        }
        /*
        if(event==EVENT_ON_TOUCH_QUICK_SWIPE_TO_TOP){
            startApp(-1);
        }else if(event==EVENT_ON_TOUCH_QUICK_SWIPE_TO_BOTTOM){
            startApp(-1);
        }*/
    #endif
    
    if(event==EVENT_BUTTON_PRESSED){
        // Write you code on [val1] button pressed here
        #if DRIVER_CONTROLS_TOTALBUTTONS > 3
            if(val1==BUTTON_BACK){
                startApp(-1);
            }
        #else 
            if(val1==BUTTON_POWER){
                startApp(-1);
            }    
        #endif
        
    }else if(event==EVENT_BUTTON_RELEASED){
        // Write you code on [val1] button released here
    }else if(event==EVENT_BUTTON_LONG_PRESS){
        // Write you code on [val1] button long press here
        if(val1==BUTTON_SELECT){

            #if DRIVER_CONTROLS_TOTALBUTTONS < 5
                startApp(-1);
            #else
            #endif
        }
    }else if(event==EVENT_ON_TIME_CHANGED){
        // Write you code on system time changed
        if(this->last_hours != core_time_getHours_String() || this->last_minutes != core_time_getMinutes_String()){
            this->draw_current_time(false);
            this->draw_current_time(true);
            #ifdef PARTIAL_DISPLAY_DRAWING
                driver_display_partial_loop();
            #endif
        }
    }else if(event==EVENT_ON_GOING_TO_SLEEP){
        this->draw_current_time(false);
    }else if(event==EVENT_ON_WAKE_UP){
        //this->draw_current_time(true);
        //fillScreen(0, 0, 0); 
        //this->onCreate();
    }else if(event==EVENT_BUTTON_DOUBLE_PRESS){
        if(val1==BUTTON_SELECT){
            startApp(-1);
        }
    }
    
}

#define APP_EPAPER_CLOCK_BIGFONT                20
#define APP_EPAPER_CLOCK_MIDDLEFONT             3
#define APP_EPAPER_CLOCK_SMALLFONT              2

#define APP_EPAPER_CLOCK_HOUR_POSITION          150
#define APP_EPAPER_CLOCK_MINUTES_POSITION       325
#define APP_EPAPER_CLOCK_MINUTES_DATE           505
#define APP_EPAPER_CLOCK_MINUTES_DAY_OF_WEEK    540
#define APP_EPAPER_CLOCK_MINUTES_BATTERY        595

bool appNameClass::draw_current_time(bool draw){
    if(draw){
        setDrawColor_ContrastColor();

        this->last_hours    = core_time_getHours_String();
        this->last_minutes  = core_time_getMinutes_String();

        this->last_date     = core_time_getDateFull();
        this->day_of_week   = core_time_getWeekDay_string();

        #ifdef BATTERY_ENABLE
            this->battery_string   = "Battery " + String(driver_battery_getPercent()) + "%";
            //this->last_battery_charging;
        #endif

        drawString_centered(this->last_hours, SCREEN_WIDTH/2, APP_EPAPER_CLOCK_HOUR_POSITION, APP_EPAPER_CLOCK_BIGFONT);
        drawString_centered(this->last_minutes, SCREEN_WIDTH/2, APP_EPAPER_CLOCK_MINUTES_POSITION, APP_EPAPER_CLOCK_BIGFONT);
        drawString_centered(this->last_date, SCREEN_WIDTH/2, APP_EPAPER_CLOCK_MINUTES_DATE, APP_EPAPER_CLOCK_MIDDLEFONT);
        drawString_centered(this->day_of_week, SCREEN_WIDTH/2, APP_EPAPER_CLOCK_MINUTES_DAY_OF_WEEK, APP_EPAPER_CLOCK_MIDDLEFONT);

        #ifdef BATTERY_ENABLE
            drawString_centered(this->battery_string, SCREEN_WIDTH/2, APP_EPAPER_CLOCK_MINUTES_BATTERY, APP_EPAPER_CLOCK_SMALLFONT);
        #endif
    }else{ 
        setDrawColor_BackGroundColor();
        clearString_centered(this->last_hours, SCREEN_WIDTH/2, APP_EPAPER_CLOCK_HOUR_POSITION, APP_EPAPER_CLOCK_BIGFONT);
        clearString_centered(this->last_minutes, SCREEN_WIDTH/2, APP_EPAPER_CLOCK_MINUTES_POSITION, APP_EPAPER_CLOCK_BIGFONT);
        clearString_centered(this->last_date, SCREEN_WIDTH/2, APP_EPAPER_CLOCK_MINUTES_DATE, APP_EPAPER_CLOCK_MIDDLEFONT);
        clearString_centered(this->day_of_week, SCREEN_WIDTH/2, APP_EPAPER_CLOCK_MINUTES_DAY_OF_WEEK, APP_EPAPER_CLOCK_MIDDLEFONT);

        #ifdef BATTERY_ENABLE
            clearString_centered(this->battery_string, SCREEN_WIDTH/2, APP_EPAPER_CLOCK_MINUTES_BATTERY, APP_EPAPER_CLOCK_SMALLFONT);
        #endif
    }
        
    return true;
}

const unsigned char appNameClass::icon[] PROGMEM = {
    
	/*            PUT YOUR ICON HERE            */
#ifdef USE_L_MENU_IMAGES
    0x02,0x01,0x02,0x28,0x02,0x28,0x04,0x00,0x66,0xff,0x00,0x00,0xFF,0x80,0x00,0x00,0x07,0xFF,0xF0,0x00,0x00,0x1F,0xFF,0xFC,0x00,0x00,0x7F,
    0xFF,0xFE,0x00,0x00,0xFF,0xFF,0xFF,0x00,0x01,0xFF,0xFF,0xFF,0x80,0x03,0xFF,0xE7,0xFF,0xC0,0x07,0xFF,0xE7,0xFF,0xE0,0x0F,0xFF,0xE7,0xFF,
    0xF0,0x1F,0xFF,0xE7,0xFF,0xF8,0x1F,0xFF,0xE7,0xFF,0xF8,0x3F,0xFF,0xE7,0xFF,0xFC,0x3F,0xFF,0xE7,0xFF,0xFC,0x3F,0xFF,0xE7,0xFF,0xFC,0x7F,
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    0x00,0x00,0x00,0x00,0x00,0x00,0x00,0x00,0x00,
#elif defined(USE_XL_MENU_IMAGES)
    /*
    #ifdef COLOR_GRAY_16
        
    #else
        
    #endif
    */
    #ifdef COLOR_GRAY_16
        0x02,0x01,0x02,0x50,0x02,0x50,0x04,0x7E,0x7E,0x7E,0x00,0x00,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0x00,
    #else
        0x02,0x01,0x02,0x50,0x02,0x50,0x04,0x00,0x00,0x60,0x00,0x00,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0x00,
    #endif
    
#else
    0x02,0x01,0x02,0x20,0x02,0x20,0x04,0x00,0x66,0xff,0x00,0x00,0x00,0x00,0x00,0x00,0x00,0x00,0x00,0x0F,0xF0,0x00,0x00,0x3F,0xFC,0x00,0x00,
    0xFF,0xFF,0x00,0x01,0xFF,0xFF,0x80,0x03,0xFF,0xFF,0xC0,0x07,0xFF,0xFF,0xE0,0x0F,0xFF,0xFF,0xF0,0x1F,0xFF,0xFF,0xE0,0x19,0xFF,0xFF,0x80,
    0x18,0x7F,0xFE,0x00,0x3E,0x1F,0xF8,0x1C,0x3F,0x87,0xE0,0x7C,0x3F,0xE1,0x81,0xFC,0x3F,0xF8,0x07,0xFC,0x3F,0xFE,0x1F,0xFC,0x3F,0xFE,0x7F,
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    0x00,0x00,0x01,0x80,0x00,0x00,0x01,0x80,0x00,0x00,0x01,0x80,0x00,0x00,0x01,0x80,0x00,0x00,0x01,0x80,0x00,
#endif
   
};
