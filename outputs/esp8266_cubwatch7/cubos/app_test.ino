#define appNameClass    TestApplicationApp         // App name without spaces
#define appName         "Test app"              // App name with spaces 

class appNameClass: public Application{
    public:
        virtual void onLoop() override;
        virtual void onDestroy() override;
        virtual void onEvent(byte event, int val1, int val2) override;

        void onCreate();
        appNameClass(){ 
            fillScreen(0, 0, 0);  // filling background
            super_onCreate();           // Drawind statusbar and etc if needed
            onCreate(); 
        };

        static unsigned const char* getParams(const unsigned char type){
            switch(type){ 
              case PARAM_TYPE_NAME: return (unsigned char*)appName; 
              case PARAM_TYPE_ICON: return icon;
              default: return (unsigned char*)""; }
        };
        const static byte icon[] PROGMEM;
      
};

void appNameClass::onCreate(){
    long time_finish;
    long time_start;

    /* * /
    fillScreen(0, 0, 0);
    setDrawColor(255, 255, 255);
    delay(10);
    time_start = millis();
    drawString("Rect test", 5, STYLE_STATUSBAR_HEIGHT + 10 + 16*0, 2);
    
    for(byte i=0; i<61; i++){
        drawRect(1+i, 120+i, 240-i, 240-i);      
    }

    time_finish = millis()-time_start;
    drawString("Finish at " + String(time_finish), 5, STYLE_STATUSBAR_HEIGHT + 10 + 16*1, 2);

    //  Results:
    // 13.02.2021 - 3442 ms
    // 13.02.2021 - 259 ms    - hardware acceleration for drawing lines

    delay(2000);
    // */

    /* * /
    const byte testIcon[] = {
        0x02,0x01,0x02,0x18,0x02,0x18,0x04,0xff,0x00,0x00,0x00,0x00,0x00,0x03,0xFF,0xC0,0x0F,0xFF,0xF0,0x1F,0xFF,0xF8,
        0x3F,0xFF,0xFC,0x3F,0xFF,0xFC,0x7F,0xFF,0xFE,0x7F,0xFF,0xFE,0x7F,0xFF,0xFE,0x7F,0xFF,0xFE,0x7F,0xFF,0xFE,0x7F,
        0xFF,0xFE,0x7F,0xFF,0xFE,0x7F,0xFF,0xFE,0x7F,0xFF,0xFE,0x7F,0xFF,0xFE,0x7F,0xFF,0xFE,0x7F,0xFF,0xFE,0x3F,0xFF,
        0xFC,0x3F,0xFF,0xFC,0x1F,0xFF,0xF8,0x0F,0xFF,0xF0,0x03,0xFF,0xC0,0x00,0x00,0x00,0x04,0xff,0xff,0xff,0x03,0xFF,
        0xC0,0x0C,0x00,0x30,0x10,0x00,0x08,0x20,0x00,0x04,0x40,0x00,0x02,0x40,0x00,0x02,0x80,0x00,0x01,0x80,0x00,0x01,
        0x80,0x00,0x01,0x80,0x00,0x01,0x80,0x00,0x01,0x80,0x00,0x01,0x80,0x00,0x01,0x80,0x00,0x01,0x80,0x00,0x01,0x80,
        0x00,0x01,0x80,0x00,0x01,0x80,0x00,0x01,0x40,0x00,0x02,0x40,0x00,0x02,0x20,0x00,0x04,0x10,0x00,0x08,0x0C,0x00,
        0x30,0x03,0xFF,0xC0,
    };
   
    fillScreen(0, 0, 0);
    core_views_statusBar_draw();
    setDrawColor(255, 255, 255);
    delay(10);
    time_start = millis();
    drawString("Icon test", 5, STYLE_STATUSBAR_HEIGHT + 10 + 16*0, 2);
    
    for(byte i=0; i<30; i++){
        drawIcon(true, testIcon, 120, 120);      
        drawIcon(false, testIcon, 120, 120);      
    }

    setDrawColor(255, 255, 255);
    time_finish = millis()-time_start;
    drawString("Finish at " + String(time_finish), 5, STYLE_STATUSBAR_HEIGHT + 10 + 16*1, 2);

    //  Results:
    // 13.02.2021 - 3581 ms
    // 13.02.2021 - 2480 ms    - Hardware acceleration for drawing lines
    // 13.02.2021 - 2476 ms    - I down`t know why, just a surprise for me
    // 13.02.2021 - 1377 ms    - Double pixels changed to fast lines
    // 13.02.2021 - 911 ms     - Clear icon with rect
    // 13.02.2021 - 833 ms     - Hardware acceleration for filling rect
    // 13.02.2021 - 828 ms     - Draw a line if more 2 pixels in raw

    delay(2000);
    // */

    /* * /
    const byte testIcon[] = {
        0x02,0x01,0x02,0x18,0x02,0x18,0x04,0xff,0x00,0x00,0x00,0x00,0x00,0x03,0xFF,0xC0,0x0F,0xFF,0xF0,0x1F,0xFF,0xF8,
        0x3F,0xFF,0xFC,0x3F,0xFF,0xFC,0x7F,0xFF,0xFE,0x7F,0xFF,0xFE,0x7F,0xFF,0xFE,0x7F,0xFF,0xFE,0x7F,0xFF,0xFE,0x7F,
        0xFF,0xFE,0x7F,0xFF,0xFE,0x7F,0xFF,0xFE,0x7F,0xFF,0xFE,0x7F,0xFF,0xFE,0x7F,0xFF,0xFE,0x7F,0xFF,0xFE,0x3F,0xFF,
        0xFC,0x3F,0xFF,0xFC,0x1F,0xFF,0xF8,0x0F,0xFF,0xF0,0x03,0xFF,0xC0,0x00,0x00,0x00,0x04,0xff,0xff,0xff,0x03,0xFF,
        0xC0,0x0C,0x00,0x30,0x10,0x00,0x08,0x20,0x00,0x04,0x40,0x00,0x02,0x40,0x00,0x02,0x80,0x00,0x01,0x80,0x00,0x01,
        0x80,0x00,0x01,0x80,0x00,0x01,0x80,0x00,0x01,0x80,0x00,0x01,0x80,0x00,0x01,0x80,0x00,0x01,0x80,0x00,0x01,0x80,
        0x00,0x01,0x80,0x00,0x01,0x80,0x00,0x01,0x40,0x00,0x02,0x40,0x00,0x02,0x20,0x00,0x04,0x10,0x00,0x08,0x0C,0x00,
        0x30,0x03,0xFF,0xC0,
    };

    fillScreen(0, 0, 0);
    core_views_statusBar_draw();
    setDrawColor(255, 255, 255);
    delay(10);
    time_start = millis();
    drawString("String test", 5, STYLE_STATUSBAR_HEIGHT + 10 + 16*0, 2);
    
    for(byte ii=0; ii<10; ii++){
        #ifdef ESP8266
            ESP.wdtDisable();
        #endif
        for(byte i=0; i<10; i++){
            setDrawColor(255, 255, 255);
            drawString("Blink string", 5, STYLE_STATUSBAR_HEIGHT + 10 + 16*5, 1);
            setDrawColor(0, 0, 0);
            //drawString("Blink string", 5, STYLE_STATUSBAR_HEIGHT + 10 + 16*5, 1);    
            clearString("Blink string", 5, STYLE_STATUSBAR_HEIGHT + 10 + 16*5, 1);    
        }
    }

    setDrawColor(255, 255, 255);
    time_finish = millis()-time_start;
    drawString("Finish at " + String(time_finish), 5, STYLE_STATUSBAR_HEIGHT + 10 + 16*1, 2);

    //  Results:
    // 13.02.2021 3170ms
    // 13.02.2021 1935ms - Hardware acceleration for drawing lines
    // 14.02.2021 1933ms - Some optimization
    // 14.02.2021 1418ms - Added function clearString

    delay(2000);
    // */
    
    /* */
    const byte testIcon[] = {
        0x02,0x01,0x02,0x18,0x02,0x18,0x04,0xff,0x00,0x00,0x00,0x00,0x00,0x03,0xFF,0xC0,0x0F,0xFF,0xF0,0x1F,0xFF,0xF8,
        0x3F,0xFF,0xFC,0x3F,0xFF,0xFC,0x7F,0xFF,0xFE,0x7F,0xFF,0xFE,0x7F,0xFF,0xFE,0x7F,0xFF,0xFE,0x7F,0xFF,0xFE,0x7F,
        0xFF,0xFE,0x7F,0xFF,0xFE,0x7F,0xFF,0xFE,0x7F,0xFF,0xFE,0x7F,0xFF,0xFE,0x7F,0xFF,0xFE,0x7F,0xFF,0xFE,0x3F,0xFF,
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        0x30,0x03,0xFF,0xC0,
    };

    fillScreen(0, 0, 0);
    core_views_statusBar_draw();
    setDrawColor(255, 255, 255);
    delay(10);
    time_start = millis();
    drawString("String test", 5, STYLE_STATUSBAR_HEIGHT + 10 + 16*0, 2);
    
    for(byte ii=0; ii<5; ii++){
        #ifdef ESP8266
            ESP.wdtDisable();
        #endif

        setDrawColor(255, 255, 255);
        drawString("Blink", 5, STYLE_STATUSBAR_HEIGHT + 10 + 16*5, 7);
        setDrawColor(0, 0, 0);
        clearString("Blink", 5, STYLE_STATUSBAR_HEIGHT + 10 + 16*5, 7);    

    }

    setDrawColor(255, 255, 255);
    time_finish = millis()-time_start;
    drawString("Finish at " + String(time_finish), 5, STYLE_STATUSBAR_HEIGHT + 10 + 16*1, 2);

    //  Results:
    // 13.02.2021 3620 ms
    // 14.02.2021 2215 ms    - Added function clearString
    // 14.02.2021 525 ms     - Draw optimization
    // 14.02.2021 504 ms     - Drawing pixels in raw with fontsize>1

    delay(2000);
    
    // */
    
}

void appNameClass::onLoop(){
    /*
        Write you code onLoop here
    */
}

void appNameClass::onDestroy(){
    /*
        Write you code onDestroy here
    */
}

void appNameClass::onEvent(byte event, int val1, int val2){
    
    if(event==EVENT_BUTTON_PRESSED){
        // Write you code on [val1] button pressed here
        if(val1==BUTTON_BACK){
            startApp(-1);
        }
    }else if(event==EVENT_BUTTON_RELEASED){
        // Write you code on [val1] button released here
    }else if(event==EVENT_BUTTON_LONG_PRESS){
        // Write you code on [val1] button long press here
    }else if(event==EVENT_ON_TIME_CHANGED){
        // Write you code on system time changed
    }
    
}

const byte appNameClass::icon[] PROGMEM = {
    
	/*            PUT YOUR ICON HERE            */
    0x02,0x01,0x02,0x20,0x02,0x20,0x04,0x6f,0x00,0xff,0x00,0x00,0x00,0x00,0x00,0x00,0x00,0x00,0x00,0x00,0x00,0x00,0x00,0x00,0x00,0x00,0x00,
    0x00,0x00,0x00,0x00,0x00,0x00,0x00,0x00,0x00,0x00,0x00,0x00,0x00,0x00,0x00,0x00,0x00,0x00,0x00,0x00,0x00,0x06,0x00,0x00,0x00,0x1E,0x00,
    0x00,0x00,0x7E,0x00,0x00,0x00,0x7E,0x00,0x00,0x00,0x7E,0x00,0x00,0x00,0x7E,0x00,0x00,0x00,0x7E,0x00,0x00,0x00,0x7E,0x00,0x00,0x00,0x78,
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    0x00,0x24,0x9A,0x00,0x00,0x24,0x92,0x00,0x00,0x38,0x92,0x00,0x00,0x00,0x00,0x00,0x00,0x00,0x00,0x00,0x00,0x00,0x00,0x00,
};