#define appNameClass    I2CScannerApp          // App name without spaces
#define appName         "I2C scanner"              // App name with spaces 

class appNameClass: public Application{
    public:
        virtual void onLoop() override;
        virtual void onDestroy() override;
        virtual void onEvent(unsigned char event, int val1, int val2, int val3, int val4, int val5) override;

        void onCreate();
        appNameClass(){ fillScreen(0, 0, 0); super_onCreate(); onCreate(); };
        static unsigned const char* getParams(const unsigned char type){
            switch(type){ 
              case PARAM_TYPE_NAME: return (unsigned char*)appName; 
              case PARAM_TYPE_ICON: return icon;
              default: return (unsigned char*)""; }
        };
        const static unsigned char icon[] PROGMEM;

    private:
        void drawStringOnScreen(String string);
        unsigned char currentString = 0;
      
};

#include <Wire.h>

void appNameClass::onCreate(){
    /*
        Write you code onCreate here
    */
    setDrawColor(255, 255, 255);
    

    Wire.begin();
    unsigned char error, address;
    int nDevices;

    drawStringOnScreen("Scanning...");
 
    nDevices = 0;
    for(address = 8; address < 127; address++ ){
        //if(address==104) continue;
        Wire.beginTransmission(address);
        error = Wire.endTransmission();
 
        #ifdef ESP8266
            ESP.wdtDisable();
        #endif

        if (error == 0){
            
            if(address==119) drawStringOnScreen(getHexStringFromByte(address) + " Barometr");
            else if(address==13) drawStringOnScreen(getHexStringFromByte(address) + " Compass");
            else if(address==104) drawStringOnScreen(getHexStringFromByte(address) + " RTC or MTU9250");
            else if(address==105) drawStringOnScreen(getHexStringFromByte(address) + " MTU9250");
            #ifdef NARROW_SCREEN
                else drawStringOnScreen(getHexStringFromByte(address) + " I2C");
            #else
                else drawStringOnScreen(getHexStringFromByte(address) + " I2C device");
            #endif
            nDevices++;
        }
        else if (error==4) {
            drawStringOnScreen("ERROR " + getHexStringFromByte(address));
        } 
    }
    if (nDevices == 0)
        drawStringOnScreen("No I2C devices found");
    else
        drawStringOnScreen("done");
 
}

void appNameClass::onLoop(){
    /*
        Write you code onLoop here
    */
}

void appNameClass::onDestroy(){
    /*
        Write you code onDestroy here
    */
}

void appNameClass::drawStringOnScreen(String string){
    drawString(string, 5, STYLE_STATUSBAR_HEIGHT + 8 + 10*currentString*FONT_SIZE_DEFAULT, FONT_SIZE_DEFAULT);
    currentString++;
}

void appNameClass::onEvent(unsigned char event, int val1, int val2, int val3, int val4, int val5){
    
    #ifdef TOUCH_SCREEN_ENABLE

        if(event==EVENT_ON_TOUCH_DRAG){
        }
        if(event==EVENT_BUTTON_PRESSED){
            if(val1==BUTTON_POWER){
                startApp(-1);
            }
        }

    #else

        /**/
        #if (DRIVER_CONTROLS_TOTALBUTTONS == 2 || DRIVER_CONTROLS_TOTALBUTTONS == 1)
            
            if(event==EVENT_BUTTON_PRESSED){
            }else if(event==EVENT_BUTTON_RELEASED){
            }else if(event==EVENT_BUTTON_LONG_PRESS){
                if(val1==BUTTON_SELECT){
                }else if(val1==BUTTON_BACK){
                    startApp(-1);
                }    
            }else if(event==EVENT_BUTTON_SHORT_PRESS){
            }else if(event==EVENT_BUTTON_SHORT_SINGLE_PRESS){
                if(val1==BUTTON_SELECT){
                }else if(val1==BUTTON_BACK){
                }
            }else if(event==EVENT_BUTTON_DOUBLE_PRESS){
                #if (DRIVER_CONTROLS_TOTALBUTTONS == 1)
                    if(val1==BUTTON_SELECT){
                        startApp(-1);
                    }
                #else
                #endif
                
            }
            
        #else
            if(event==EVENT_BUTTON_PRESSED){
            
            }else if(event==EVENT_BUTTON_RELEASED){

            }else if(event==EVENT_BUTTON_LONG_PRESS){

            }
        #endif
    
    #endif
    
}

const unsigned char appNameClass::icon[] PROGMEM = {
    
	/*            PUT YOUR ICON HERE            */

    #ifdef USE_L_MENU_IMAGES
    #elif defined(USE_XL_MENU_IMAGES)
        #ifdef COLOR_GRAY_16
            0x02,0x01,0x02,0x50,0x02,0x50,0x04,0x7E,0x7E,0x7E,0x00,0x00,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0x00,
        #else
            0x02,0x01,0x02,0x50,0x02,0x50,0x04,0x00,0x00,0x33,0x00,0x00,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0x00,
        #endif
    #else
    0x02,0x01,0x02,0x20,0x02,0x20,0x04,0xff,0xd9,0x00,0x00,0x30,0x00,0x00,0x00,0x48,0x00,0x00,0x3C,0x08,0x1F,
    0xE0,0x3C,0x10,0x3F,0xF8,0x3C,0x20,0x78,0x3C,0x3C,0x78,0xF0,0x1C,0x3C,0x00,0xE0,0x1C,0x3C,0x00,0xE0,0x00,
    0x3C,0x00,0xE0,0x00,0x3C,0x00,0xE0,0x00,0x3C,0x00,0xE0,0x00,0x3C,0x00,0xE0,0x00,0x3C,0x00,0xE0,0x00,0x3C,
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    0x80,0x20,0x10,
    #endif
};